## boards/shields/beaudin_v2/Kconfig.defconfig
```kconfig
if SHIELD_BEAUDIN_V2_LEFT

# Settings for left side only
config ZMK_KEYBOARD_NAME
    default "Beaudin BT"

config ZMK_SPLIT_ROLE_CENTRAL
    default y

endif

# Settings for either left or right side
if SHIELD_BEAUDIN_V2_LEFT || SHIELD_BEAUDIN_V2_RIGHT

config ZMK_SPLIT
    default y

CONFIG_ZMK_DISPLAY_STATUS_SCREEN_BUILT_IN=y
CONFIG_ZMK_LV_FONT_DEFAULT_SMALL_MONTSERRAT_26=y
CONFIG_LV_FONT_DEFAULT_MONTSERRAT_26=y

endif # SHIELD_BEAUDIN_V2_LEFT || SHIELD_BEAUDIN_V2_RIGHT
```
